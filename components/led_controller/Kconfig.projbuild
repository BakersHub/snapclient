## components/led_controller/Kconfig.projbuild
```kconfig
menu "LED Controller Configuration"

    config ENABLE_LED_CONTROLLER
        bool "Enable LED Controller"
        default n
        help
            Enable sound-reactive LED controller for WS2812B/SK6812 strips.
            This adds minimal LED control via RMT with audio-reactive effects.

    config LED_GPIO_PIN
        int "LED Data GPIO Pin"
        depends on ENABLE_LED_CONTROLLER
        default 5
        help
            GPIO pin connected to the LED strip data line.
            Common pins: GPIO5, GPIO18, GPIO19, GPIO23

    config LED_NUM_LEDS
        int "Number of LEDs"
        depends on ENABLE_LED_CONTROLLER
        default 30
        range 1 300
        help
            Total number of LEDs in the strip.
            Keep this reasonable to avoid excessive memory usage.

    config LED_DEFAULT_BRIGHTNESS
        int "Default Brightness (0-255)"
        depends on ENABLE_LED_CONTROLLER
        default 128
        range 0 255
        help
            Default LED brightness on startup.
            0 = off, 255 = maximum brightness

    config LED_DEFAULT_EFFECT
        int "Default Effect"
        depends on ENABLE_LED_CONTROLLER
        default 1
        range 0 10
        help
            Default LED effect on startup.
            0=Off, 1=VU Meter, 2=Spectrum, 3=Pulse, 4=Wave, 5=Energy Bar,
            6=Rainbow Pulse, 7=Beat Flash, 8=Bass Pulse, 9=Stereo VU, 10=Solid

    config LED_DEFAULT_SENSITIVITY
        int "Default Audio Sensitivity (0-255)"
        depends on ENABLE_LED_CONTROLLER
        default 150
        range 0 255
        help
            Default audio sensitivity for reactive effects.
            Higher values = more sensitive to audio input.

    config LED_DEFAULT_SPEED
        int "Default Animation Speed (0-255)"
        depends on ENABLE_LED_CONTROLLER
        default 128
        range 0 255
        help
            Default animation speed for effects like pulse and wave.

endmenu
```

## main/Kconfig.projbuild
```kconfig
menu "Snapclient Configuration"
    config SNAPSERVER_USE_MDNS
        bool "Use mDNS"
        default true
        help
            Use mDNS to look for the snapserver to connect to on the local network.

    config SNAPSERVER_HOST
        string "Snapserver host"
        default "192.168.1.158"
        depends on !SNAPSERVER_USE_MDNS
        help
            Host (ip or name) of snapserver to connect to if mDNS is disabled or the mDNS resolution fails.

    config SNAPSERVER_PORT
        int "Snapserver port"
        default 1704
        depends on !SNAPSERVER_USE_MDNS
        help
            Port of the snapserver to connect to.

    config SNAPCLIENT_NAME
        string "snapclient name"
        default "ESP32-Caster"
        help
            Name of the client to register the snapserver.

	menu "HTTP Server Setting"
		config WEB_PORT
			int "User interface HTTP Server Port"
			default 8000
			help
				HTTP server port to use.
	endmenu

	config USE_SAMPLE_INSERTION
        bool "Use sample insertion"
        default true
        help
            There are two syncronization implementations.

            1. APLL tuning (ONLY use with DACs having MCLK input)
            2. sample insertion (duplicates a sample now and then to keep up sync)

            Both approaches have similar performance keeping clients in sync <= 500µs

	menu "Volume Control"
		config ENABLE_VOLUME_BUTTONS
			bool "Enable Volume Control Buttons"
			default y
			help
				Enable GPIO-based volume up/down buttons.

		config VOLUME_UP_PIN
			int "Volume UP button GPIO"
			default 27
			depends on ENABLE_VOLUME_BUTTONS
			help
				GPIO pin for volume UP button (active HIGH with pull-down).

		config VOLUME_DOWN_PIN
			int "Volume DOWN button GPIO"
			default 14
			depends on ENABLE_VOLUME_BUTTONS
			help
				GPIO pin for volume DOWN button (active HIGH with pull-down).

		config SNAPCAST_GAIN_BOOST
			string "Volume Gain Boost Multiplier"
			default "0.1"
			help
				Gain boost multiplier applied to volume to match A2DP loudness levels.
				Default is 1.0 (0% boost). Use values like 0.5, 1.0, 1.5, etc.
				Higher values increase overall volume, lower values decrease it.
	endmenu

	menu "SH1106 Display Configuration"
		config ENABLE_SH1106_DISPLAY
			bool "Enable SH1106 OLED Display"
			default y
			help
				Enable SH1106 128x64 OLED display support for showing device name, WiFi signal, and audio visualization.

		config SH1106_I2C_SDA_GPIO
			int "I2C SDA GPIO"
			default 21
			depends on ENABLE_SH1106_DISPLAY
			help
				GPIO pin for I2C SDA (data line).

		config SH1106_I2C_SCL_GPIO
			int "I2C SCL GPIO"
			default 22
			depends on ENABLE_SH1106_DISPLAY
			help
				GPIO pin for I2C SCL (clock line).

		config SH1106_I2C_FREQ_HZ
			int "I2C Frequency (Hz)"
			default 400000
			depends on ENABLE_SH1106_DISPLAY
			help
				I2C bus frequency in Hz.

		config SH1106_I2C_ADDRESS
			hex "I2C Address"
			default 0x3C
			depends on ENABLE_SH1106_DISPLAY
			help
				I2C address of the SH1106 display (usually 0x3C or 0x3D).

		config SH1106_DISPLAY_OFFSET
			int "Vertical display offset (rows)"
			default 0
			depends on ENABLE_SH1106_DISPLAY
			help
				Vertical offset applied via the SH1106/SSD1306 SETDISPLAYOFFSET command.
				Use 0 for most 0.96" 128x64 modules; some 1.28" SH1106 panels
				may need a small non-zero offset so the content is vertically centered.

		config SH1106_COLUMN_OFFSET
			int "Horizontal column offset (pixels)"
			default 2
			depends on ENABLE_SH1106_DISPLAY
			help
				Horizontal column offset for the panel. Classic SH1106 1.28" modules
				typically use 2, while many 0.96" SSD1306 128x64 modules use 0.
	endmenu

endmenu
```
